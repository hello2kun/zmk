## app/boards/shields/YG40Teeth/Kconfig.defconfig
```kconfig
# Copyright (c) 2020 The ZMK Contributors
# SPDX-License-Identifier: MIT

if SHIELD_YG40TEETH

config ZMK_KEYBOARD_NAME
    default "YG40Teeth"

config ZMK_HID_REPORT_TYPE_NKRO
    true

config ZMK_HID_KEYBOARD_NKRO_EXTENDED_REPORT
    true

endif
```

## app/boards/shields/YGPad/Kconfig.defconfig
```kconfig
# Copyright (c) 2020 The ZMK Contributors
# SPDX-License-Identifier: MIT

if SHIELD_YGPad

config ZMK_KEYBOARD_NAME
    default "YGPad"

endif
```

## app/boards/shields/YGTeeth55/Kconfig.defconfig
```kconfig
# Copyright (c) 2020 The ZMK Contributors
# SPDX-License-Identifier: MIT

if SHIELD_YGTEETH55

config ZMK_KEYBOARD_NAME
    default "YGTeeth55"

endif
```

## app/boards/shields/YGTeeth55/Kconfig.shield
```kconfig
# Copyright (c) 2020 The ZMK Contributors
# SPDX-License-Identifier: MIT

config SHIELD_YGTEETH55
    def_bool $(shields_list_contains,YGTeeth55)
```

## app/boards/shields/YGTeeth56_ChocV2/Kconfig.defconfig
```kconfig
# Copyright (c) 2020 The ZMK Contributors
# SPDX-License-Identifier: MIT

if SHIELD_YGTEETH56_ChocV2

config ZMK_KEYBOARD_NAME
    default "YGTeeth56_ChocV2"

endif
```

## app/boards/shields/YGTeeth56_ChocV2/Kconfig.shield
```kconfig
# Copyright (c) 2020 The ZMK Contributors
# SPDX-License-Identifier: MIT

config SHIELD_YGTEETH56_ChocV2
    def_bool $(shields_list_contains,YGTeeth56_ChocV2)
```

## app/boards/shields/YGTeeth56_V3/Kconfig.shield
```kconfig
# Copyright (c) 2020 The ZMK Contributors
# SPDX-License-Identifier: MIT

config SHIELD_YGTEETH56_V3
    def_bool $(shields_list_contains,YGTeeth56_V3)
```
